#include <Adafruit_GFX.h>
#include <Adafruit_SSD1306.h>
#include <Wire.h>
#include <Adafruit_MLX90614.h>
#include <Fonts/FreeMonoBold18pt7b.h> 



Adafruit_SSD1306 display(128, 64);           
Adafruit_MLX90614 mlx = Adafruit_MLX90614();  


const unsigned char PROGMEM frame0 [] = {0x00, 0x00, 0x00, 0x00, 0x00, 0x00, 0x00, 0x00, 0x00, 0x00, 0x00, 0x00, 0x00,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 0x00, 0x00};




int GREEN=2;
int RED=7;

float reading[30];
float total ;
float temperature ;

void setup() {  
 
   pinMode(GREEN,OUTPUT);    
   pinMode(RED,OUTPUT); 
  
  
   
  delay(100);  

  display.begin(SSD1306_SWITCHCAPVCC, 0x3C);  
  display.clearDisplay(); 
  display.setTextColor(WHITE);  
  mlx.begin();  


}


int xx =42;
int yy=20;
int tt=0;



void loop() {
  display.clearDisplay();


total=0;
for (int i=0; i<30; i++)
{
  float value =mlx.readObjectTempC();
reading[i]= value *1;
total = total + reading[i];
delay (5);
}
temperature = total / 30.0;

  if(temperature>30){
  display.clearDisplay(); 
  display.setFont();
  display.setCursor(10,10);  // (x,y)
  display.println("VÜCUT SICAKLIĞINIZ");  // Text or value to print
  display.setCursor(14,2);  // (x,y)
  display.println(".");  // Text or value to print
  display.setCursor(17,2);  // (x,y)
  display.println(".");  // Text or value to print
  display.setCursor(88,4);  // (x,y)
  display.println("-");  // Text or value to print
  
  display.setFont(&FreeMonoBold18pt7b);  // Set a custom font
  display.setCursor(10,55);  // (x,y)
  display.println(temperature,1);
   display.setCursor(100,55);  // (x,y)
  display.println("C");  // Text or value to print
  display.setCursor(88,37);  // (x,y)
  display.println(".");  // Text or value to print 
  
  }

  if(mlx.readObjectTempC()<=30){
 

display.clearDisplay(); 
  display.setFont();
  display.setCursor(10,10);  // (x,y)
  display.println("SpecialCase Robot");  // Text or value to print
//display.clearDisplay();
display.drawBitmap(xx, yy,frame0,48,48, 1);
display.display();
delay(tt);



  }




 
   
  if((temperature)>=32 && (temperature)<=37  ){
    digitalWrite(GREEN,HIGH);
   digitalWrite(RED,LOW);
  }
  else if((temperature)>37) {
     digitalWrite(RED,HIGH);
     digitalWrite(GREEN,LOW);
     
  }
  else if((temperature)>38) {
     digitalWrite(RED,HIGH);
     digitalWrite(GREEN,LOW);
      
  }
else  {
     digitalWrite(RED,LOW);
     digitalWrite(GREEN,LOW);
}
 
  display.display();

}
